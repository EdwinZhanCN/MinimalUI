## platforms/esp32/sdkconfig.defaults
```kconfig
# ESP32 configuration defaults for MinimalUI

# Enable C++ support
CONFIG_COMPILER_CXX_EXCEPTIONS=y
CONFIG_COMPILER_CXX_RTTI=y

# FreeRTOS configuration
CONFIG_FREERTOS_HZ=1000
CONFIG_FREERTOS_TIMER_TASK_STACK_DEPTH=2048

# SPI configuration
CONFIG_SPI_MASTER_IN_IRAM=y
CONFIG_SPI_MASTER_ISR_IN_IRAM=y

# GPIO configuration
CONFIG_GPIO_ESP32_SUPPORT_SWITCH_SLP_PULL=y

# Memory configuration - For ESP32-C6 use 160MHz
CONFIG_ESP32C6_DEFAULT_CPU_FREQ_160=y
CONFIG_ESP32C6_DEFAULT_CPU_FREQ_MHZ=160

# Power Management - Keep simple
CONFIG_PM_ENABLE=n

# Auto Light Sleep - Explicitly disable
CONFIG_FREERTOS_USE_TICKLESS_IDLE=n

# Logging configuration
CONFIG_LOG_DEFAULT_LEVEL_INFO=y
CONFIG_LOG_DEFAULT_LEVEL=3

# Main task configuration
CONFIG_ESP_MAIN_TASK_STACK_SIZE=8192

# Enable hardware acceleration
CONFIG_ESP32_SPIRAM_SUPPORT=n
CONFIG_SPIRAM_USE_MALLOC=n

# Compiler optimization
CONFIG_COMPILER_OPTIMIZATION_SIZE=y

# Partition table
CONFIG_PARTITION_TABLE_SINGLE_APP=y

# Serial console
CONFIG_ESP_CONSOLE_UART_DEFAULT=y
CONFIG_ESP_CONSOLE_UART_BAUDRATE_115200=y

# Watchdog configuration - Disable to avoid conflicts
CONFIG_ESP_TASK_WDT_EN=n
CONFIG_ESP_TASK_WDT_INIT=n

# USB configuration for ESP32-C6
CONFIG_ESP_CONSOLE_USB_SERIAL_JTAG=y
CONFIG_ESP_CONSOLE_SECONDARY_NONE=y
```
